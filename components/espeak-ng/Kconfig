## components/espeak-ng/Kconfig
```kconfig
# SPDX-License-Identifier: GPL-3.0-or-later
# Configuration catalogue of the component (FSD §19). Options arrive with the
# requirements that use them.
menu "eSpeak NG (espk)"

    config ESPK_PARTITION_LABEL
        string "Data partition label"
        default "espeak"

    config ESPK_PARTITION_SUBTYPE
        hex "Data partition subtype"
        default 0x40

    config ESPK_MOUNT_POINT
        string "Read-only VFS mount point of the data"
        default "/espeak"

    config ESPK_DEFAULT_VOICE
        string "Initial voice"
        default "en"

    config ESPK_BSS_IN_PSRAM
        bool "Place the engine's .bss in PSRAM (about 60 KB of internal RAM freed)"
        default y
        select SPIRAM_ALLOW_BSS_SEG_EXTERNAL_MEMORY
        help
            Done by a linker fragment over the upstream's objects; the sources stay untouched.
            Turn it off to keep the engine's statics in internal RAM (faster, 60 KB dearer).

    config ESPK_ASYNC
        bool "Asynchronous layer: espk_say() and espk_cancel() over a synthesis task"
        default y

    config ESPK_TASK_STACK
        int "Synthesis task stack, bytes"
        depends on ESPK_ASYNC
        default 65536
        help
            The engine's deepest call chain measured about 39 KB on the AlertAlergo port;
            49152 is the floor (FR-ASY-06).

    config ESPK_TASK_STACK_PSRAM
        bool "Place the synthesis task's stack in PSRAM"
        depends on ESPK_ASYNC
        default y

    config ESPK_TASK_PRIORITY
        int "Synthesis task priority"
        depends on ESPK_ASYNC
        default 5

    config ESPK_QUEUE_LEN
        int "Requests that can wait behind the one being spoken"
        depends on ESPK_ASYNC
        default 4

    config ESPK_UCD_WRAP
        bool "Classify wide characters with ucd-tools (issue espeak-ng#1611)"
        default y
        help
            The ESP32 libc knows no letter beyond ASCII, so accented text is spelled out
            letter by letter. With this option the linker redirects the engine's isw*
            calls to the upstream's ucd-tools (the engine's sources stay untouched).
            Note that --wrap acts on the whole application's link, not only on the engine.
            Turn it off to get the upstream's behaviour on the ESP32 libc as it is.

    config ESPK_MAX_TEXT_LEN
        int "Longest text accepted, in bytes"
        default 1024

endmenu
```

## examples/waveshare-s3-rlcd/main/Kconfig.projbuild
```kconfig
# SPDX-License-Identifier: GPL-3.0-or-later
menu "waveshare-s3-rlcd example"

    config EXAMPLE_CODEC_RATE
        int "Sample rate the codec runs at, Hz"
        default 22050
        help
            The engine makes 22 050 Hz. If the codec runs at another rate the example resamples the PCM
            (main/resample.h); at 22 050 Hz the PCM goes to the codec as it is.

    config EXAMPLE_VOLUME
        int "Volume, 0 to 100"
        default 5
        range 0 100

endmenu
```
